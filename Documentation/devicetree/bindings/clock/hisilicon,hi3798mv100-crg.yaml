## Documentation/devicetree/bindings/clock/hisilicon,hi3798mv100-crg.yaml
```yaml
# SPDX-License-Identifier: GPL-2.0-only OR BSD-2-Clause
%YAML 1.2
---
$id: http://devicetree.org/schemas/clock/hisilicon,hi3798mv100-crg.yaml#
$schema: http://devicetree.org/meta-schemas/core.yaml#

title: HiSilicon Hi3798MV100 Clock and Reset Generator

maintainers:
  - linux-arm-kernel@lists.infradead.org

description: |
  The Hi3798MV100 exposes clock and reset control through two register
  blocks. The peripheral CRG covers most on-SoC devices, while the system
  controller covers the always-on domain (UART0, IR, watchdog reset).

  Both blocks also act as syscon providers: other drivers reach single
  configuration bits inside them by phandle.

  Clock and reset indices are defined in
  include/dt-bindings/clock/histb-clock.h.

# The peripheral CRG also answers to "hisilicon,cpuctrl", which is how the
# shared mach-hisi SMP code finds it. That compatible belongs to
# arm/hisilicon/controller/cpuctrl.yaml, so select on our own names only.
select:
  properties:
    compatible:
      contains:
        enum:
          - hisilicon,hi3798mv100-crg
          - hisilicon,hi3798mv100-sysctrl
  required:
    - compatible

properties:
  compatible:
    oneOf:
      - items:
          - const: hisilicon,hi3798mv100-crg
          - const: hisilicon,cpuctrl
          - const: syscon
          - const: simple-mfd
      - items:
          - const: hisilicon,hi3798mv100-sysctrl
          - const: syscon

  reg:
    maxItems: 1

  hisilicon,sysctrl:
    $ref: /schemas/types.yaml#/definitions/phandle
    description:
      Phandle to the system controller. The CPU clock reads its locked
      frequency selection from a bit that lives in that block.

  hisilicon,perictrl:
    $ref: /schemas/types.yaml#/definitions/phandle
    description:
      Phandle to the peripheral controller. The GPU clock mux drives its
      low-power handshake through that block.

  '#clock-cells':
    const: 1

  '#reset-cells':
    description:
      Register offset within the block, followed by the bit number.
    const: 2

required:
  - compatible
  - reg
  - '#clock-cells'
  - '#reset-cells'

additionalProperties: false

examples:
  - |
    clock-controller@8a22000 {
        compatible = "hisilicon,hi3798mv100-crg", "hisilicon,cpuctrl",
                     "syscon", "simple-mfd";
        reg = <0x8a22000 0x2000>;
        hisilicon,sysctrl = <&sysctrl>;
        hisilicon,perictrl = <&perictrl>;
        #clock-cells = <1>;
        #reset-cells = <2>;
    };
```

## Documentation/devicetree/bindings/display/hisilicon/hisilicon,hi3798mv100-hdmi.yaml
```yaml
# SPDX-License-Identifier: GPL-2.0-only
# Copyright (c) 2026 Hisilicon community
%YAML 1.2
---
$id: http://devicetree.org/schemas/display/hisilicon/hisilicon,hi3798mv100-hdmi.yaml#
$schema: http://devicetree.org/meta-schemas/core.yaml#

title: HiSilicon Hi3798MV100 HDMI transmitter with integrated PHY

allOf:
  - $ref: /schemas/sound/dai-common.yaml#

maintainers:
  - Hisilicon STB Platform <linux-arm-kernel@lists.infradead.org>

description: |
  Hi3798MV100 HDMI 1.4 transmitter block with integrated PHY control and
  internal DDC/HPD handling logic.

  The block provides:
    - video output path from VDP to HDMI connector;
    - HDMI audio codec endpoint via #sound-dai-cells for simple-audio-card
      integration;
    - CEC clock domain required by the internal CEC function.

properties:
  compatible:
    const: hisilicon,hi3798mv100-hdmi

  reg:
    maxItems: 1

  interrupts:
    maxItems: 1

  clocks:
    minItems: 7
    maxItems: 7

  clock-names:
    items:
      - const: bus
      - const: cec
      - const: id
      - const: mhl
      - const: os
      - const: as
      - const: phy_bus

  resets:
    minItems: 3
    maxItems: 3

  reset-names:
    items:
      - const: bus
      - const: ctrl
      - const: phy

  "#sound-dai-cells":
    const: 0

  sound-name-prefix: true

  hisilicon,crg-syscon:
    $ref: /schemas/types.yaml#/definitions/phandle
    description:
      Phandle to CRG syscon used for HDMI clock/reset and TX clock source
      configuration.

  hisilicon,peripheral-syscon:
    $ref: /schemas/types.yaml#/definitions/phandle
    description:
      Phandle to peripheral syscon used by HDMI control/audio source routing.

  pinctrl-names:
    oneOf:
      - items:
          - const: default
      - items:
          - const: default
          - const: gpio

  pinctrl-0: true
  pinctrl-1: true

  ports:
    $ref: /schemas/graph.yaml#/properties/ports

    properties:
      "#address-cells":
        const: 1
      "#size-cells":
        const: 0

      port@0:
        $ref: /schemas/graph.yaml#/properties/port
        description:
          HDMI video input from VDP output endpoint.

      port@1:
        $ref: /schemas/graph.yaml#/properties/port
        description:
          HDMI TMDS output towards an HDMI connector endpoint.

    unevaluatedProperties: false

required:
  - compatible
  - reg
  - interrupts
  - clocks
  - clock-names
  - resets
  - reset-names
  - "#sound-dai-cells"
  - hisilicon,crg-syscon
  - hisilicon,peripheral-syscon

additionalProperties: false

examples:
  - |
    #include <dt-bindings/clock/histb-clock.h>
    #include <dt-bindings/interrupt-controller/arm-gic.h>

    soc {
        #address-cells = <1>;
        #size-cells = <1>;

        vdp {
            compatible = "hisilicon,hi3798mv100-vdp";

            ports {
                #address-cells = <1>;
                #size-cells = <0>;

                port@0 {
                    reg = <0>;

                    vdp_out: endpoint {
                        remote-endpoint = <&hdmi_in>;
                    };
                };
            };
        };

        hdmi: hdmi@8ce0000 {
            compatible = "hisilicon,hi3798mv100-hdmi";
            reg = <0x8ce0000 0x20000>;
            interrupts = <GIC_SPI 88 IRQ_TYPE_LEVEL_HIGH>;
            clocks = <&crg HISTB_HDMI_TX_BUS_CLK>,
                     <&crg HISTB_HDMI_TX_CEC_CLK>,
                     <&crg HISTB_HDMI_TX_ID_CLK>,
                     <&crg HISTB_HDMI_TX_MHL_CLK>,
                     <&crg HISTB_HDMI_TX_OS_CLK>,
                     <&crg HISTB_HDMI_TX_AS_CLK>,
                     <&crg HISTB_HDMI_PHY_BUS_CLK>;
            clock-names = "bus", "cec", "id", "mhl", "os", "as", "phy_bus";
            resets = <&crg 0x10c 8>, <&crg 0x10c 9>, <&crg 0x110 4>;
            reset-names = "bus", "ctrl", "phy";
            #sound-dai-cells = <0>;
            hisilicon,crg-syscon = <&crg>;
            hisilicon,peripheral-syscon = <&perictrl>;
            pinctrl-names = "default", "gpio";
            pinctrl-0 = <&hdmi_ddc_default_pins>;
            pinctrl-1 = <&hdmi_ddc_gpio_pins>;

            ports {
                #address-cells = <1>;
                #size-cells = <0>;

                port@0 {
                    reg = <0>;

                    hdmi_in: endpoint {
                        remote-endpoint = <&vdp_out>;
                    };
                };

                port@1 {
                    reg = <1>;

                    hdmi_out: endpoint {
                        remote-endpoint = <&hdmi_con_in>;
                    };
                };
            };
        };

        hdmi-connector {
            compatible = "hdmi-connector";
            type = "a";

            port {
                hdmi_con_in: endpoint {
                    remote-endpoint = <&hdmi_out>;
                };
            };
        };
    };
```

## Documentation/devicetree/bindings/display/hisilicon/hisilicon,hi3798mv100-vdp-drm.yaml
```yaml
# SPDX-License-Identifier: GPL-2.0-only OR BSD-2-Clause
%YAML 1.2
---
$id: http://devicetree.org/schemas/display/hisilicon/hisilicon,hi3798mv100-vdp-drm.yaml#
$schema: http://devicetree.org/meta-schemas/core.yaml#

title: HiSilicon Hi3798MV100 DRM/KMS output

maintainers:
  - linux-arm-kernel@lists.infradead.org

description: >
  Virtual node tying the Hi3798MV100 display pipeline together. It owns no
  registers of its own - it names the blocks that make up the pipeline and
  registers the resulting DRM device.

properties:
  compatible:
    const: hisilicon,hi3798mv100-vdp-drm

  ports:
    $ref: /schemas/types.yaml#/definitions/phandle-array
    items:
      maxItems: 1
    minItems: 2
    maxItems: 2
    description: |
      Graph endpoints of the blocks forming the display pipeline, in order:
      the VDP display controller output that drives the CRTC, and the HDMI
      transmitter output.

required:
  - compatible
  - ports

additionalProperties: false

examples:
  - |
    drm {
        compatible = "hisilicon,hi3798mv100-vdp-drm";
        ports = <&vdp_out>, <&hdmi_out>;
    };
```

## Documentation/devicetree/bindings/display/hisilicon/hisilicon,hi3798mv100-vdp.yaml
```yaml
# SPDX-License-Identifier: GPL-2.0-only
# Copyright (c) 2026 Hisilicon community
%YAML 1.2
---
$id: http://devicetree.org/schemas/display/hisilicon/hisilicon,hi3798mv100-vdp.yaml#
$schema: http://devicetree.org/meta-schemas/core.yaml#

title: HiSilicon Hi3798MV100 Video Display Processor (VDP)

maintainers:
  - Hisilicon STB Platform <linux-arm-kernel@lists.infradead.org>

description: |
  The Hi3798MV100 VDP is the display controller block used to fetch frame data
  from memory, compose graphics/video layers and drive the display output path.
  It is typically connected to an HDMI transmitter block through a DT graph.

properties:
  compatible:
    const: hisilicon,hi3798mv100-vdp

  reg:
    maxItems: 1

  interrupts:
    maxItems: 1

  clocks:
    minItems: 6
    maxItems: 6

  clock-names:
    items:
      - const: bus
      - const: vo
      - const: sd
      - const: sdate
      - const: hd
      - const: hdate

  resets:
    maxItems: 1

  reset-names:
    items:
      - const: vou

  hisilicon,crg-syscon:
    $ref: /schemas/types.yaml#/definitions/phandle
    description:
      Phandle to the CRG syscon used for mode-dependent VDP clock/PLL control.

  port:
    $ref: /schemas/graph.yaml#/properties/port
    description:
      VDP output routed to the next display block, the HDMI transmitter.

required:
  - compatible
  - reg
  - interrupts
  - clocks
  - clock-names
  - resets
  - reset-names
  - hisilicon,crg-syscon
  - port

additionalProperties: false

examples:
  - |
    #include <dt-bindings/clock/histb-clock.h>
    #include <dt-bindings/interrupt-controller/arm-gic.h>

    soc {
        #address-cells = <1>;
        #size-cells = <1>;

        vdp: display-controller@8cc0000 {
            compatible = "hisilicon,hi3798mv100-vdp";
            reg = <0x8cc0000 0x10000>;
            interrupts = <GIC_SPI 90 IRQ_TYPE_LEVEL_HIGH>;
            clocks = <&crg HISTB_VO_BUS_CLK>,
                     <&crg HISTB_VO_CLK>,
                     <&crg HISTB_VO_SD_CLK>,
                     <&crg HISTB_VO_SDATE_CLK>,
                     <&crg HISTB_VO_HD_CLK>,
                     <&crg HISTB_VO_HDATE_CLK>;
            clock-names = "bus", "vo", "sd", "sdate", "hd", "hdate";
            resets = <&crg 0xd8 30>;
            reset-names = "vou";
            hisilicon,crg-syscon = <&crg>;

            port {
                vdp_out: endpoint {
                    remote-endpoint = <&hdmi_in>;
                };
            };
        };

        hdmi-tx {
            compatible = "hisilicon,hi3798mv100-hdmi";

            ports {
                #address-cells = <1>;
                #size-cells = <0>;

                port@0 {
                    reg = <0>;

                    hdmi_in: endpoint {
                        remote-endpoint = <&vdp_out>;
                    };
                };
            };
        };
    };
```

## Documentation/devicetree/bindings/regulator/hisilicon,hi3798mv100-volt.yaml
```yaml
# SPDX-License-Identifier: GPL-2.0-only OR BSD-2-Clause
%YAML 1.2
---
$id: http://devicetree.org/schemas/regulator/hisilicon,hi3798mv100-volt.yaml#
$schema: http://devicetree.org/meta-schemas/core.yaml#

title: HiSilicon Hi3798MV100 PWM Voltage Regulator

maintainers:
  - linux-arm-kernel@lists.infradead.org

allOf:
  - $ref: regulator.yaml#

properties:
  compatible:
    const: hisilicon,hi3798mv100-volt

  reg:
    maxItems: 1

  reg-names:
    items:
      - const: base-address

required:
  - compatible
  - reg
  - regulator-name
  - regulator-min-microvolt
  - regulator-max-microvolt

unevaluatedProperties: false

examples:
  - |
    vdd_cpu: regulator@8a2301c {
      compatible = "hisilicon,hi3798mv100-volt";
      reg = <0x8a2301c 0x4>;
      reg-names = "base-address";
      regulator-name = "vdd-cpu";
      regulator-min-microvolt = <920000>;
      regulator-max-microvolt = <1495000>;
      regulator-boot-on;
      regulator-always-on;
    };
...
```

## Documentation/devicetree/bindings/sound/hisilicon,hi3798mv100-aiao.yaml
```yaml
# SPDX-License-Identifier: GPL-2.0
%YAML 1.2
---
$id: http://devicetree.org/schemas/sound/hisilicon,hi3798mv100-aiao.yaml#
$schema: http://devicetree.org/meta-schemas/core.yaml#

title: HiSilicon Hi3798MV100 Audio Input/Output Controller (AIAO)

maintainers:
  - Hisilicon STB Platform <linux-arm-kernel@lists.infradead.org>

description: |
  Hi3798MV100 Audio Input/Output controller block used as a parent bus for
  I2S transmit interfaces.

properties:
  compatible:
    items:
      - const: hisilicon,hi3798mv100-aiao
      - const: simple-bus

  reg:
    maxItems: 1

  interrupts:
    maxItems: 1

  clocks:
    maxItems: 1

  clock-names:
    items:
      - const: aiao

  resets:
    maxItems: 1

  reset-names:
    items:
      - const: core

  "#address-cells":
    const: 1

  "#size-cells":
    const: 1

  ranges: true

required:
  - compatible
  - reg
  - interrupts
  - clocks
  - clock-names
  - "#address-cells"
  - "#size-cells"
  - ranges

patternProperties:
  "^i2s@[0-9a-f]+$":
    type: object
    properties:
      compatible:
        const: hisilicon,hi3798mv100-i2s

      reg:
        maxItems: 1

      interrupts:
        maxItems: 1

      clocks:
        maxItems: 1

      clock-names:
        items:
          - const: mclk

      resets:
        maxItems: 1

      reset-names:
        items:
          - const: core

      "#sound-dai-cells":
        const: 0

    required:
      - compatible
      - reg
      - "#sound-dai-cells"

    additionalProperties: false

unevaluatedProperties: false

examples:
  - |
    #include <dt-bindings/clock/histb-clock.h>
    #include <dt-bindings/interrupt-controller/arm-gic.h>

    soc {
        #address-cells = <1>;
        #size-cells = <1>;

        aiao: aiao@8cd0000 {
            compatible = "hisilicon,hi3798mv100-aiao", "simple-bus";
            reg = <0x8cd0000 0x10000>;
            interrupts = <GIC_SPI 84 IRQ_TYPE_LEVEL_HIGH>;
            clocks = <&crg HISTB_AIAO_CLK>;
            clock-names = "aiao";
            resets = <&crg 0x118 4>;
            reset-names = "core";
            #address-cells = <1>;
            #size-cells = <1>;
            ranges = <0x0 0x8cd0000 0x10000>;

            i2s@2000 {
                compatible = "hisilicon,hi3798mv100-i2s";
                reg = <0x2000 0x100>;
                interrupts = <GIC_SPI 84 IRQ_TYPE_LEVEL_HIGH>;
                clocks = <&crg HISTB_AIAO_CLK>;
                clock-names = "mclk";
                resets = <&crg 0x118 4>;
                reset-names = "core";
                #sound-dai-cells = <0>;
            };
        };
    };
```
