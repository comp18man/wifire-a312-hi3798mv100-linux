## Documentation/devicetree/bindings/timer/hisilicon,hisp804.yaml
```yaml
# SPDX-License-Identifier: GPL-2.0-only OR BSD-2-Clause
%YAML 1.2
---
$id: http://devicetree.org/schemas/timer/hisilicon,hisp804.yaml#
$schema: http://devicetree.org/meta-schemas/core.yaml#

title: HiSilicon SP804 timer group

maintainers:
  - linux-arm-kernel@lists.infradead.org

description: |
  HiSilicon STB SoCs carry several ARM SP804 dual timers. This binding
  describes the group of them that the kernel drives as one unit: the
  first timer becomes the system clocksource and sched_clock, and each
  remaining timer becomes the clockevent of one CPU.

  The timers only run in NORMAL power state - they stop in SLOW and DOZE -
  and their input rate is fixed at 24 MHz.

properties:
  compatible:
    const: hisilicon,hisp804

  reg:
    minItems: 2
    maxItems: 5
    description:
      One entry for the clocksource timer, followed by one entry per CPU
      for the per-CPU clockevent timers.

  interrupts:
    minItems: 1
    maxItems: 4
    description:
      One interrupt per per-CPU clockevent timer, in the same order as the
      matching reg entries. The clocksource timer has no interrupt.

  clocks:
    maxItems: 1

  clock-names:
    items:
      - const: apb_pclk

required:
  - compatible
  - reg
  - interrupts
  - clocks
  - clock-names

additionalProperties: false

examples:
  - |
    #include <dt-bindings/interrupt-controller/arm-gic.h>

    timer@8a29000 {
        compatible = "hisilicon,hisp804";
        reg = <0x8a29000 0x20>,
              <0x8a2a000 0x20>,
              <0x8a2a020 0x20>,
              <0x8a2b000 0x20>,
              <0x8a2b020 0x20>;
        interrupts = <GIC_SPI 26 IRQ_TYPE_LEVEL_HIGH>,
                     <GIC_SPI 59 IRQ_TYPE_LEVEL_HIGH>,
                     <GIC_SPI 27 IRQ_TYPE_LEVEL_HIGH>,
                     <GIC_SPI 60 IRQ_TYPE_LEVEL_HIGH>;
        clocks = <&xtal24mhz>;
        clock-names = "apb_pclk";
    };
```

## arch/arm/configs/hi3798mv100_defconfig
```kconfig
CONFIG_LOCALVERSION="-hi3798mv100"
# CONFIG_LOCALVERSION_AUTO is not set

CONFIG_ARCH_HISI=y
CONFIG_SMP=y
CONFIG_MCPM=y
CONFIG_NR_CPUS=4
CONFIG_HIGHMEM=y
CONFIG_ARM_APPENDED_DTB=y
CONFIG_ARM_ATAG_DTB_COMPAT=y
CONFIG_VFP=y
CONFIG_VFPv3=y
CONFIG_NEON=y
CONFIG_PM_OPP=y
CONFIG_CMA=y
CONFIG_DMA_CMA=y
CONFIG_PRINTK_TIME=y
CONFIG_CMDLINE=""
CONFIG_CMDLINE_EXTEND=y

CONFIG_CPU_FREQ=y
CONFIG_CPUFREQ_DT=y
CONFIG_CPU_FREQ_STAT=y
CONFIG_CPU_FREQ_DEFAULT_GOV_SCHEDUTIL=y
CONFIG_CPU_FREQ_GOV_PERFORMANCE=y
CONFIG_CPU_FREQ_GOV_POWERSAVE=y
CONFIG_CPU_FREQ_GOV_USERSPACE=y
CONFIG_CPU_FREQ_GOV_ONDEMAND=y
CONFIG_CPU_FREQ_GOV_CONSERVATIVE=y
CONFIG_CPU_FREQ_GOV_SCHEDUTIL=y

CONFIG_KERNEL_MODE_NEON=y

CONFIG_APM_EMULATION=y
CONFIG_ENERGY_MODEL=y

CONFIG_MFD_SYSCON=y
CONFIG_COMMON_CLK_HI3798MV100=y
CONFIG_RESET_HISI=y

CONFIG_SERIAL_AMBA_PL011=y
CONFIG_SERIAL_AMBA_PL011_CONSOLE=y

CONFIG_PINCTRL=y
CONFIG_PINCTRL_SINGLE=y
CONFIG_GPIO_PL061=y
CONFIG_LEDS_GPIO=y
CONFIG_LEDS_TRIGGERS=y
CONFIG_LEDS_TRIGGER_NETDEV=y
CONFIG_LED_TRIGGER_PHY=y

CONFIG_I2C=y
CONFIG_I2C_HIX5HD2=y
CONFIG_SPI=y
CONFIG_SPI_PL022=y
CONFIG_SPI_SPIDEV=y

CONFIG_REGULATOR=y
CONFIG_REGULATOR_FIXED_VOLTAGE=y
CONFIG_REGULATOR_HI3798MV100=y

CONFIG_HISI_FEMAC=y
CONFIG_MDIO_HISI_FEMAC=y

CONFIG_MMC=y
CONFIG_MMC_BLOCK=y
CONFIG_MMC_DW=y
CONFIG_MMC_DW_PLTFM=y
CONFIG_MMC_DW_HI3798CV200=y
CONFIG_PARTITION_ADVANCED=y
CONFIG_CMDLINE_PARTITION=y
CONFIG_EXT4_FS=y

CONFIG_USB=y
CONFIG_USB_EHCI_HCD=y
CONFIG_USB_EHCI_HCD_PLATFORM=y
CONFIG_USB_OHCI_HCD=y
CONFIG_USB_OHCI_HCD_PLATFORM=y
CONFIG_USB_OHCI_LITTLE_ENDIAN=y
CONFIG_PHY_HISI_INNO_USB2=y

CONFIG_THERMAL=y
CONFIG_HISI_THERMAL=y
CONFIG_WATCHDOG=y
CONFIG_ARM_SP805_WATCHDOG=y
CONFIG_HW_RANDOM_HISTB=y

CONFIG_MEDIA_SUPPORT=y
CONFIG_MEDIA_SUPPORT_FILTER=y
CONFIG_MEDIA_CEC_SUPPORT=y

CONFIG_DRM=y
CONFIG_DRM_HISI_HISTB_VDP=y
CONFIG_DRM_HISI_HISTB_HDMI=y
CONFIG_DRM_HISI_HISTB_DRM=y
CONFIG_DRM_LIMA=y

CONFIG_SOUND=y
CONFIG_SND=y
CONFIG_SND_SOC=y
CONFIG_SND_SIMPLE_CARD=y
CONFIG_SND_SOC_HDMI_CODEC=y
CONFIG_SND_SOC_HI3798MV100_I2S=y

CONFIG_RTL8192DU=y

CONFIG_RC_CORE=y
CONFIG_LIRC=y
CONFIG_RC_MAP=y
CONFIG_RC_DECODERS=y
CONFIG_IR_NEC_DECODER=y
CONFIG_IR_RC5_DECODER=y
CONFIG_IR_RC6_DECODER=y
CONFIG_IR_SONY_DECODER=y
CONFIG_RC_DEVICES=y
CONFIG_IR_HIX5HD2=y
CONFIG_INPUT_EVDEV=y

# Keep defconfig for hi3798mv100:
# disable unrelated drivers that default to y under ARCH_HISI.
# CONFIG_COMMON_CLK_HI3516CV300 is not set
# CONFIG_COMMON_CLK_HI3519 is not set
# CONFIG_COMMON_CLK_HI3559A is not set
# CONFIG_COMMON_CLK_HI3660 is not set
# CONFIG_COMMON_CLK_HI3670 is not set
# CONFIG_COMMON_CLK_HI3798CV200 is not set
# CONFIG_COMMON_CLK_HI6220 is not set
# CONFIG_COMMON_RESET_HI3660 is not set
# CONFIG_COMMON_RESET_HI6220 is not set
# CONFIG_HI3660_MBOX is not set
# CONFIG_HI6220_MBOX is not set
# CONFIG_HIX5HD2_GMAC is not set
# CONFIG_HW_RANDOM_HISI is not set
```

## drivers/gpu/drm/hisilicon/histb/Kconfig
```kconfig
# SPDX-License-Identifier: GPL-2.0-only
config DRM_HISI_HISTB_VDP
	tristate "HiSilicon STB VDP support"
	depends on DRM && OF && COMMON_CLK && RESET_CONTROLLER
	depends on MFD_SYSCON
	depends on ARCH_HISI || COMPILE_TEST
	help
	  Video display processor of the HiSilicon STB SoCs, as found on
	  hi3798mv100. Drives the graphics and video layers and the mixer,
	  and provides the scanout the DRM driver builds on.

	  Say Y if you want display output on such a SoC.

config DRM_HISI_HISTB_HDMI
	tristate "HiSilicon STB HDMI support"
	depends on DRM && OF && COMMON_CLK && RESET_CONTROLLER
	depends on MFD_SYSCON
	depends on ARCH_HISI || COMPILE_TEST
	help
	  HDMI transmitter and PHY of the HiSilicon STB SoCs, as found on
	  hi3798mv100. Registers a DRM bridge with an HDMI audio codec,
	  and reads the sink EDID.

	  Say Y if you want HDMI output on such a SoC.

config DRM_HISI_HISTB_DRM
	tristate "HiSilicon STB DRM/KMS output"
	depends on DRM && OF
	depends on DRM_HISI_HISTB_VDP
	depends on DRM_HISI_HISTB_HDMI
	depends on ARCH_HISI || COMPILE_TEST
	select DRM_DISPLAY_HELPER
	select DRM_BRIDGE_CONNECTOR
	select DRM_CLIENT_SELECTION
	select DRM_DISPLAY_HDCP_HELPER
	select DRM_KMS_HELPER
	select DRM_GEM_DMA_HELPER
	help
	  Atomic DRM/KMS driver tying the histb VDP and HDMI blocks together.
	  Provides /dev/dri/card* with one CRTC, a graphics and a video plane,
	  dumb buffers and fbdev emulation.

	  Say Y to expose the display pipeline to userspace.
```

## sound/soc/hisilicon/Kconfig
```kconfig
# SPDX-License-Identifier: GPL-2.0-only
menu "Hisilicon"

config SND_I2S_HI6210_I2S
	tristate "Hisilicon I2S controller"
	select SND_SOC_GENERIC_DMAENGINE_PCM
	help
	  Hisilicon I2S

config SND_SOC_HI3798MV100_I2S
	tristate "HiSilicon Hi3798MV100 I2S controller"
	depends on ARCH_HISI || COMPILE_TEST
	depends on COMMON_CLK
	select SND_SOC_HDMI_CODEC
	help
	  ASoC CPU DAI driver for the HiSilicon Hi3798MV100 AIAO I2S
	  transmit interface.

endmenu
```
